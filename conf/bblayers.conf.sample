## conf/bblayers.conf.sample
```bitbake
# LAYER_CONF_VERSION is increased each time build/conf/bblayers.conf
# changes incompatibly
LCONF_VERSION = "4"

BBFILES ?= ""
BBLAYERS = " \
  ##COREBASE##/poky/meta \
  ##COREBASE##/poky/meta-yocto \
  ##COREBASE##/meta-ivi \
  ##COREBASE##/meta-temp \
  ##COREBASE##/meta-systemd \
  "
```

## conf/distro/include/default-providers-ivi.inc
```bitbake
#
# Default virtual providers
#
PREFERRED_PROVIDER_virtual/arm-oe-linux-gnueabi-depmod ?= "kmod-cross"
PREFERRED_PROVIDER_udev ?= "systemd"
PREFERRED_PROVIDER_udev-utils ?= "systemd"
PREFERRED_PROVIDER_node-state-manager ?= "node-state-manager"
```

## conf/distro/poky-ivi-systemd.conf
```bitbake
DISTRO = "poky-ivi-systemd"
DISTRO_NAME = "Yocto GENIVI Baseline (Poky/meta-ivi)"
DISTRO_VERSION = "5.0+snapshot-${DATE}"
DISTRO_CODENAME ="gemini"

MAINTAINER = "meta-ivi <genivi-meta-ivi@lists.genivi.org>"

TARGET_VENDOR = "-poky"

LAYER_CONF_VERSION ?= "6"

include conf/distro/include/default-providers-ivi.inc

VIRTUAL-RUNTIME_init_manager = "systemd"
VIRTUAL-RUNTIME_initscripts = ""

DISTRO_FEATURES_append = " bluetooth systemd opengl wayland pam"
DISTRO_FEATURES_BACKFILL_CONSIDERED = "sysvinit"

PREFERRED_VERSION_linux-yocto ?= "3.10%"
PREFERRED_VERSION_linux-yocto_qemux86 ?= "3.10%"
PREFERRED_VERSION_linux-yocto_qemux86-64 ?= "3.10%"
PREFERRED_VERSION_linux-yocto_qemuarm ?= "3.10%"
PREFERRED_VERSION_linux-yocto_vexpressa9 ?= "3.10%"

PREFERRED_PROVIDER_jpeg = "jpeg"
PREFERRED_PROVIDER_jpeg-native = "jpeg-native"

TCLIBCAPPEND = ""

QEMU_TARGETS ?= "arm i386 x86_64"

XSERVER ?= "xserver-xorg \
           xserver-xf86-config \
           xserver-xorg-extension-dbe \
           xserver-xorg-extension-dri \
           xserver-xorg-extension-dri2 \
           xserver-xorg-extension-extmod \
           xserver-xorg-extension-glx \
           xf86-input-evdev \
           xf86-input-mouse \
           xf86-input-keyboard \
           mesa-driver-swrast \
           ${@base_contains("MACHINE_ARCH", "qemux86", "xf86-video-vmware", "", d)} \
           ${@base_contains("MACHINE_ARCH", "qemux86_64", "xf86-video-vmware", "", d)} \
           ${@base_contains("MACHINE_ARCH", "vexpressa9", "xf86-video-fbdev", "", d)} \
          "

PREMIRRORS ??= "\
bzr://.*/.*   http://downloads.yoctoproject.org/mirror/sources/ \n \
cvs://.*/.*   http://downloads.yoctoproject.org/mirror/sources/ \n \
git://.*/.*   http://downloads.yoctoproject.org/mirror/sources/ \n \
hg://.*/.*    http://downloads.yoctoproject.org/mirror/sources/ \n \
osc://.*/.*   http://downloads.yoctoproject.org/mirror/sources/ \n \
p4://.*/.*    http://downloads.yoctoproject.org/mirror/sources/ \n \
svk://.*/.*   http://downloads.yoctoproject.org/mirror/sources/ \n \
svn://.*/.*   http://downloads.yoctoproject.org/mirror/sources/ \n"

MIRRORS =+ "\
ftp://.*/.*      http://downloads.yoctoproject.org/mirror/sources/ \n \
http://.*/.*     http://downloads.yoctoproject.org/mirror/sources/ \n \
https://.*/.*    http://downloads.yoctoproject.org/mirror/sources/ \n"

# The CONNECTIVITY_CHECK_URI's are used to test whether we can succesfully
# fetch from the network (and warn you if not). To disable the test set
# the variable to be empty.
# Git example url: git://git.yoctoproject.org/yocto-firewall-test;protocol=git;rev=HEAD

CONNECTIVITY_CHECK_URIS ?= " \
             https://eula-downloads.yoctoproject.org/index.php \
             http://bugs.genivi.org/report.cgi"

# Default hash policy for distro
BB_SIGNATURE_HANDLER ?= 'OEBasicHash'
#
# OELAYOUT_ABI allows us to notify users when the format of TMPDIR changes in
# an incompatible way. Such changes should usually be detailed in the commit
# that breaks the format and have been previously discussed on the mailing list
# with general agreement from the core team.
#
OELAYOUT_ABI = "8"

# QA check settings - a little stricter than the OE-Core defaults
WARN_QA = "textrel files-invalid incompatible-license xorg-driver-abi libdir"
ERROR_QA = "dev-so debug-deps dev-deps debug-files arch pkgconfig la perms \
            useless-rpaths rpaths staticdev ldflags pkgvarcheck already-stripped \
            compile-host-path dep-cmp installed-vs-shipped install-host-path \
            packages-list perm-config perm-line perm-link pkgv-undefined \
            pn-overrides split-strip var-undefined"

include conf/distro/include/seperatebuilddir.inc
```

## meta-ivi-bsp/conf/machine/vexpressa9.conf
```bitbake
#@TYPE: Machine
#@NAME: vexpress-a9 machine
#@DESCRIPTION: Machine configuration for the vexpress a9 board 

PREFERRED_PROVIDER_virtual/xserver = "xserver-xorg"

# Ship all kernel modules by default
MACHINE_EXTRA_RRECOMMENDS = " kernel-modules"

# Uncomment the following line to enable the hard floating point abi. Note that
# this breaks some binary libraries and 3D (neither of which ship with
# meta-yocto). For maximum compatibility, leave this disabled.
#DEFAULTTUNE ?= "cortexa8hf-neon"
include conf/machine/include/tune-cortexa9.inc

IMAGE_FSTYPES += "tar.bz2 ext3"
EXTRA_IMAGECMD_jffs2 = "-lnp "

SERIAL_CONSOLES = "115200;ttyAMA0 115200;ttyAMA1"

PREFERRED_PROVIDER_virtual/kernel ?= "linux-yocto"

KERNEL_IMAGETYPE = "zImage"
KERNEL_DEVICETREE = "vexpress-v2p-ca9.dtb"

UBOOT_MACHINE = "ca9x4_ct_vxp_config"
UBOOT_ENTRYPOINT = "0x80008000"
UBOOT_LOADADDRESS = "0x80008000"
KERNEL_EXTRA_ARGS += "LOADADDR=${UBOOT_ENTRYPOINT}"

MACHINE_FEATURES = "kernel26 apm usbgadget usbhost vfat alsa"
```

## meta-ivi-test/conf/layer.conf
```bitbake
# We have a conf and classes directory, add to BBPATH
BBPATH .= ":${LAYERDIR}"

# We have recipes-* directories, add to BBFILES
BBFILES += "${LAYERDIR}/recipes-*/*/*.bb \
            ${LAYERDIR}/recipes-*/*/*.bbappend"

BBFILE_COLLECTIONS += "ivitest"
BBFILE_PATTERN_ivitest = "^${LAYERDIR}/"
BBFILE_PRIORITY_ivitest = "7"

LAYERSERIES_COMPAT_ivitest = "sumo"
```

## meta-ivi-test/conf/machine/minnowmax.conf
```bitbake
#@TYPE: Machine
#@NAME: minnowmax board
#@SOC: intel-corei7-64
#@DESCRIPTION: Machine configuration for Intel Minnowboard MAX
#@MAINTAINER: Yong-iL Joh <yong-il.joh@windriver.com>

MACHINEOVERRIDES =. "intel-corei7-64:"

include conf/machine/intel-corei7-64.conf

MACHINE_FEATURES_append = " sgx"

SDKIMAGE_FEATURES_append = " staticdev-pkgs"
IMAGE_INSTALL_append = " mesa-megadriver"

#PREFERRED_VERSION_audiomanager ?= "7.0"
#PREFERRED_VERSION_audiomanagerplugins ?= "7.0"

# see http://www.rodsbooks.com/efi-bootloaders/index.html
EFI_PROVIDER = "gummiboot"
RDEPENDS_initramfs-live-install_remove = "grub parted"
RDEPENDS_initramfs-live-install-efi_remove = "parted"
```

## meta-ivi/conf/bblayers.conf.sample
```bitbake
# LAYER_CONF_VERSION is increased each time build/conf/bblayers.conf
# changes incompatibly
LCONF_VERSION = "6"

BBPATH = "${TOPDIR}"
BBFILES ?= ""

BBLAYERS ?= " \
  ##OEROOT##/meta \
  ##OEROOT##/meta-poky \
  ##OEROOT##/meta-yocto-bsp \
  ##OEROOT##/../meta-openembedded/meta-oe \
  ##OEROOT##/../meta-openembedded/meta-filesystems \
  ##OEROOT##/../meta-ivi/meta-ivi \
  ##OEROOT##/../meta-ivi/meta-ivi-bsp \
  ##OEROOT##/../meta-gplv2 \
  "
BBLAYERS_NON_REMOVABLE ?= " \
  ##OEROOT##/meta \
  ##OEROOT##/meta-poky \
  ##OEROOT##/../meta-ivi/meta-ivi \
  "
```

## meta-ivi/conf/distro/include/default-providers-ivi.inc
```bitbake
#
# Default virtual providers
#
PREFERRED_PROVIDER_udev ?= "systemd"
PREFERRED_PROVIDER_udev-utils ?= "systemd"
PREFERRED_PROVIDER_node-state-manager ?= "node-state-manager"

#
# Default jpeg provider
#
PREFERRED_PROVIDER_jpeg ?= "jpeg"
PREFERRED_PROVIDER_jpeg-native ?= "jpeg-native"
```

## meta-ivi/conf/distro/poky-ivi-systemd.conf
```bitbake
require conf/distro/poky.conf

DISTRO = "poky-ivi-systemd"
DISTRO_NAME = "Yocto GENIVI Baseline (Poky/meta-ivi)"
DISTRO_VERSION = "14.0.0"
DISTRO_CODENAME = "pulsar"

MAINTAINER = "meta-ivi <genivi-meta-ivi@lists.genivi.org>"

POKY_DEFAULT_DISTRO_FEATURES = "\
    bluetooth \
    largefile \
    opengl \
    pam \
    systemd \
    wayland \
"

include conf/distro/include/default-providers-ivi.inc
# Conflicts with wayland. It is possible run wayland
# on-top of x11 but that is not a use-case that we support
DISTRO_FEATURES_remove = "x11 directfb"

PREFERRED_PROVIDER_udev ?= "systemd"
PREFERRED_PROVIDER_udev-utils ?= "systemd"
VIRTUAL-RUNTIME_init_manager = "systemd"
VIRTUAL-RUNTIME_initscripts = ""

DISTRO_FEATURES_BACKFILL_CONSIDERED = "sysvinit"

# FIXME: these pkgs are apparently broken when enabling (some of) the
# security_flags, so they are therefore blacklisted here, (or the flags
# are _partially) applied)
SECURITY_CFLAGS_pn-lttng-ust = "${SECURITY_NO_PIE_CFLAGS}"
SECURITY_CFLAGS_pn-persistence-administrator = ""
SECURITY_LDFLAGS_pn-persistence-administrator = ""

SECURITY_CFLAGS_pn-keyutils = ""
SECURITY_LDFLAGS_pn-keyutils = ""
SECURITY_CFLAGS_pn-v86d = ""
SECURITY_LDFLAGS_pn-v86d = ""
SECURITY_CFLAGS_pn-gettext = ""
SECURITY_LDFLAGS_pn-gettext = ""

# The unused variable was still there in dbus-1.12 (during certain #ifdef
# conditions).  It seems to be fixed later, so this can be set to empty
# string again.
SECURITY_CFLAGS_pn-dbus = "-Wno-error=unused-variable"

QEMU_TARGETS ?= "arm aarch64 i386 x86_64"
```

## meta-ivi/conf/layer.conf
```bitbake
BBPATH ?= ""
# We add conf directory to BBPATH
BBPATH .= ":${LAYERDIR}"

# We have a recipes directory containing .bb and .bbappend files, add to BBFILES
BBFILES += "${LAYERDIR}/recipes-*/*/*.bb \
            ${LAYERDIR}/recipes-*/*/*.bbappend"

BBFILE_COLLECTIONS += "ivi"
BBFILE_PATTERN_ivi := "^${LAYERDIR}/"
BBFILE_PRIORITY_ivi = "7"

# Define a similar VARIABLE to COREBASE in order to get a reference to
# top directory easily
IVI_COREBASE := '${@os.path.normpath("${LAYERDIR}/../")}'
```
